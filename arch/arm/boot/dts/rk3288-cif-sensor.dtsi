#include "rk3288.dtsi" 
#include "rk3288-pinctrl.dtsi"
#include "../../mach-rockchip/rk_camera_sensor_info.h"
/{
	rk3288_cif_sensor: rk3288_cif_sensor{
			compatible = "rockchip,sensor";
			status = "okay";
			
    ov2659{
		is_front = <1>;
        rockchip,power = <&gpio0 GPIO_C1 GPIO_ACTIVE_HIGH>;
		rockchip,powerdown = <&gpio2 GPIO_B6 GPIO_ACTIVE_HIGH>;
		pwdn_active = <ov2659_PWRDN_ACTIVE>;
        pwr_active = <PWR_ACTIVE_HIGH>;
		mir = <0>;
		flash_attach = <1>;
		flash_active = <1>;
		resolution = <ov2659_FULL_RESOLUTION>;
        powerup_sequence = <ov2659_PWRSEQ>;
		orientation = <0>;		
		i2c_add = <ov2659_I2C_ADDR>;
		i2c_rata = <100000>;
		i2c_chl = <3>;
		cif_chl = <0>;
		mclk_rate = <24>;
		};

    ov5640{
		is_front = <0>;
        rockchip,power = <&gpio0 GPIO_C1 GPIO_ACTIVE_HIGH>;
		rockchip,powerdown = <&gpio2 GPIO_B6 GPIO_ACTIVE_HIGH>;
		pwdn_active = <ov5640_PWRDN_ACTIVE>;
        pwr_active = <PWR_ACTIVE_HIGH>;
		mir = <0>;
		flash_attach = <0>;
		flash_active = <0>;
		resolution = <ov5640_FULL_RESOLUTION>;
        powerup_sequence = <ov5640_PWRSEQ>;
		orientation = <0>;		
		i2c_add = <ov5640_I2C_ADDR>;
		i2c_rata = <100000>;
		i2c_chl = <3>;
		cif_chl = <0>;
		mclk_rate = <24>;
		};

	};
};






